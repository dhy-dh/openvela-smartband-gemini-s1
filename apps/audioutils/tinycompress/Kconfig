## apps/testing/libc/clocktest/Kconfig
```kconfig
#
# For a description of the syntax of this configuration file,
# see the file kconfig-language.txt in the NuttX tools repository.
#

config TESTING_CLOCKTEST
	tristate "Clock test"
	default n
	depends on TESTING_CMOCKA
	---help---
		Enable the Clock test

if TESTING_CLOCKTEST

config TESTING_CLOCKTEST_PROGNAME
	string "clocktest"
	default "clocktest"
	---help---
		The name of the program that will be used when the NSH ELF
		program is installed.

config TESTING_CLOCKTEST_PRIORITY
	int "Clock test task priority"
	default 100

config TESTING_CLOCKTEST_STACKSIZE
	int "Clock test task stack size"
	default DEFAULT_TASK_STACKSIZE

endif
```

## apps/testing/libc/ratelimit/Kconfig
```kconfig
#
# For a description of the syntax of this configuration file,
# see the file kconfig-language.txt in the NuttX tools repository.
#

config TESTING_RATELIMIT
	tristate "cmocka RATELIMIT test"
	default n
	depends on TESTING_CMOCKA
	---help---
		Enable the cmocka RATELIMIT test

if TESTING_RATELIMIT

config TESTING_RATELIMIT_PRIORITY
	int "Task priority"
	default 100

config TESTING_RATELIMIT_STACKSIZE
	int "Stack size"
	default DEFAULT_TASK_STACKSIZE

endif
```

## apps/testing/mm/tlsftest/Kconfig
```kconfig
#
# For a description of the syntax of this configuration file,
# see the file kconfig-language.txt in the NuttX tools repository.
#

config TESTING_TLSF
	tristate "TLSF Memory Management test"
	default n
	---help---
		Enable the TLSF Memory Management test

if TESTING_TLSF

config TESTING_TLSF_PROGNAME
	string "Program name"
	default "tlsftest"
	---help---
		This is the name of the program that will be used when the NSH ELF
		program is installed.

config TESTING_TLSF_PRIORITY
	int "tlsf test priority"
	default 101

config TESTING_TLSF_STACKSIZE
	int "tlsf test stack size"
	default DEFAULT_TASK_STACKSIZE

endif
```

## apps/testing/rpmsg/Kconfig
```kconfig
#
# For a description of the syntax of this configuration file,
# see the file kconfig-language.txt in the NuttX tools repository.
#

config TESTING_RPMSG
	tristate "cmocka rpmsg test"
	default n
	---help---
		Enable cmocka rpmsg test

if TESTING_RPMSG
	config TESTING_RPMSG_PRIORITY
		int "cmocka rpmsgtest task priority"
		default 100

	config TESTING_RPMSG_STACKSIZE
		int "cmocka rpmsgtest stack size"
		default DEFAULT_TASK_STACKSIZE

	config TESTING_RPMSGMTD
		tristate "cmocka rpmsgmtd test"
		default y
		depends on (RPMSGMTD_SERVER && RAMMTD) || RPMSGMTD
		---help---
			Enable cmocka rpmsgmtd test

	config TESTING_RPMSGBLK
		tristate "cmocka rpmsgblk test"
		default y
		depends on BUILD_FLAT && (BLK_RPMSG_SERVER || BLK_RPMSG)
		---help---
			Enable cmocka rpmsgblk test
endif
```

## apps/testing/sched/events/Kconfig
```kconfig
#
# For a description of the syntax of this configuration file,
# see the file kconfig-language.txt in the NuttX tools repository.
#

config TESTING_PERF
	tristate "Perf event test"
	default n
	depends on SCHED_PERF_EVENTS
	---help---
		Support Perf event test

if TESTING_PERF

config TESTING_PERF_PRIORITY
	int "Perf event test task priority"
	default 100

config TESTING_PERF_STACKSIZE
	int "Perf event test stack size"
	default DEFAULT_TASK_STACKSIZE

endif
```

## apps/testing/testsuites/Kconfig
```kconfig
#
# For a description of the syntax of this configuration file,
# see the file kconfig-language.txt in the NuttX tools repository.
#

config TESTS_TESTSUITES
	tristate "vela test suite"
	default n
	depends on TESTING_CMOCKA
	---help---
		Enable testsuites for the vela

if TESTS_TESTSUITES

menu "Testsuite cases"

config TESTS_TESTSUITES_MOUNT_DIR
	string "Mount directory for the testsuites"
	default "/data"

config TESTS_TESTSUITES_PRIORITY
	int "Testsuites task priority"
	default 99

config TESTS_TESTSUITES_STACKSIZE
	int "Testsuites stack size"
	default 16384

config CM_FS_TEST
	bool "enable fs test"
	default n
	depends on FS_LINKS

config CM_SCHED_TEST
	bool "enbale schedule test"
	default n

config CM_SYSCALL_TEST
	bool "enbale syscall test"
	default n
	depends on PIPES && SCHED_HAVE_PARENT && FS_TMPFS && ARCH_SETJMP_H && FS_LINKS

config CM_MM_TEST
	bool "enbale MM test"
	default n

config CM_KVDB_TEST
	bool "enbale kvdb test"
	default n
	depends on KVDB

if CM_KVDB_TEST

config KVDB_LOAD_TEST_SOURCE_PATH
	string "database default value test source path"
	default "/data/test.prop"
	depends on KVDB_SERVER

endif # CM_KVDB_TEST

config CM_TIME_TEST
	bool "enbale time test"
	default n
	depends on SIG_EVTHREAD
	depends on !DISABLE_POSIX_TIMERS

config CM_SOCKET_TEST
	bool "enbale socket test"
	default n
	depends on NET && NETDEV_LATEINIT

config CM_PTHREAD_TEST
	bool "enbale pthread test"
	default n

config CM_MUTEX_TEST
	bool "enbale mutex test"
	default n

config CM_DFX_TEST
	bool "enbale dfx test"
	default n
	depends on NETUTILS_CJSON && DFX && DFX_EVENT

endmenu
endif # TESTS_TESTSUITES
```
