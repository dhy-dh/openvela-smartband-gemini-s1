## apps/audioutils/tinycompress/Kconfig
```kconfig
#
# For a description of the syntax of this configuration file,
# see the file kconfig-language.txt in the NuttX tools repository.
#

config AUDIOUTILS_TINYCOMPRESS
	bool "Enable tinycompress"
	default n

if AUDIOUTILS_TINYCOMPRESS

config AUDIOUTILS_TINYCOMPRESS_CPLAY
	bool "Enable tinycompress cplay tool"
	default n

config AUDIOUTILS_TINYCOMPRESS_CRECORD
	bool "Enable tinycompress crecord tool"
	default n

endif # AUDIOUTILS_TINYCOMPRESS
```

## apps/benchmarks/ramspeed/Kconfig
```kconfig
#
# For a description of the syntax of this configuration file,
# see the file kconfig-language.txt in the NuttX tools repository.
#

config BENCHMARK_RAMSPEED
	tristate "RAM Speed Test"
	default n
	depends on LIBC_FLOATINGPOINT
	---help---
		Enable a simple RAM speed test.

if BENCHMARK_RAMSPEED

config BENCHMARK_RAMSPEED_PROGNAME
	string "Program name"
	default "ramspeed"
	---help---
		This is the name of the program that will be used when the NSH ELF
		program is installed.

config BENCHMARK_RAMSPEED_PRIORITY
	int "RAM speed test task priority"
	default 100

config BENCHMARK_RAMSPEED_STACKSIZE
	int "RAM speed test stack size"
	default DEFAULT_TASK_STACKSIZE

config RAMSPEED_MONOTONIC_TIME
	bool "Benchmark ramspeed using clock gettime"
	default n
	---help---
		When you turn on this option, your test loop will go from 10000 -> 1000 times
		Please consider the following scenario:
		1. By default (PERFTIME) will have a relatively high precision, but this also
			tends to cause failure in getting values on some smaller bytes, so reducing
			the precision with this option can make it easier to get data values.
		2. whether to compare data with the content of other tools (using CLOCK
			GETTIME method), if so, it is recommended to turn on, so as to ensure that
			the data precision of both consistent.

endif
```

## apps/examples/ivshmem_test/Kconfig
```kconfig
#
# For a description of the syntax of this configuration file,
# see the file kconfig-language.txt in the NuttX tools repository.
#

config EXAMPLES_IVSHMEM
	tristate "IVSHM example"
	default n
	depends on PCI_UIO_IVSHMEM
	---help---
		Enable the IVSHMEM example

if EXAMPLES_IVSHMEM

config EXAMPLES_IVSHMEM_PROGNAME
	string "Program name"
	default "ivshmem_test"
	---help---
		This is the name of the program that will be used when the NSH ELF
		program is installed.

config EXAMPLES_IVSHMEM_PRIORITY
	int "IVSHMEM task priority"
	default 100

config EXAMPLES_IVSHMEM_STACKSIZE
	int "IVSHMEM stack size"
	default DEFAULT_TASK_STACKSIZE

config EXAMPLES_IVSHMEM_DEVICE
	string "path to uio device"
	default "/dev/uio0"

config EXAMPLES_IVSHMEM_MEMSIZE
	int "shared memory size"
	default 4096

endif
```

## apps/examples/memory_pressure/Kconfig
```kconfig
#
# For a description of the syntax of this configuration file,
# see the file kconfig-language.txt in the NuttX tools repository.
#

config EXAMPLES_MEMORY_PRESSURE
	tristate "Memory pressure example"
	default n
	depends on FS_PROCFS_INCLUDE_PRESSURE
	---help---
		Enable the memory pressure example

if EXAMPLES_MEMORY_PRESSURE

config EXAMPLES_MEMORY_PRESSURE_PROGNAME
	string "Program name"
	default "pressure"
	---help---
		This is the name of the program that will be used when the NSH ELF
		program is installed.

config EXAMPLES_MEMORY_PRESSURE_PRIORITY
	int "Memory pressure task priority"
	default 100

config EXAMPLES_MEMORY_PRESSURE_STACKSIZE
	int "Memory pressure stack size"
	default DEFAULT_TASK_STACKSIZE

config EXAMPLES_MEMORY_PRESSURE_HEAPSIZE
	int "Memory pressure heap size"
	depends on MM_TASK_HEAP
	default MM_TASK_HEAP_DEFAULT_SIZE

endif
```

## apps/examples/rpmsgchar/Kconfig
```kconfig
#
# For a description of the syntax of this configuration file,
# see the file kconfig-language.txt in the NuttX tools repository.
#

config EXAMPLES_RPMSGCHAR
	tristate "Rpmsg char example"
	depends on RPMSG_CHAR
	default n
	---help---
		Enable the rpmsg char test example
```

## apps/graphics/lvctl/Kconfig
```kconfig
#
# For a description of the syntax of this configuration file,
# see the file kconfig-language.txt in the NuttX tools repository.
#

config GRAPHICS_LVCTL
	tristate "LVGL control utility"
	default y
	depends on GRAPHICS_LVGL
	depends on LV_USE_NUTTX_LIBUV
	depends on LV_USE_REMOTE_CTRL
	---help---
		LVGL control utility command line tool

if GRAPHICS_LVCTL

config GRAPHICS_LVCTL_PRIORITY
	int "LVCTL priority"
	default 100

config GRAPHICS_LVCTL_STACKSIZE
	int "LVCTL stack size"
	default 4096

endif
```

## apps/netutils/connectedhomeip/Kconfig
```kconfig
#
# For a description of the syntax of this configuration file,
# see the file kconfig-language.txt in the NuttX tools repository.
#

config MATTER
	bool "Connected Home over IP (CHIP)"
	default n
	---help---
		Enable the Connected Home over IP (CHIP)

if MATTER

config MATTER_LOG
	bool "Build matter with logs"
	default n
	---help---
		To reduce flash size, logs are not opened by default

choice
	prompt "Matter Example Configuration"
	default MATTER_EXAMPLE_LIGHTING

config MATTER_EXAMPLE_LIGHTING
	bool "Enable Lighting Example"

config MATTER_EXAMPLE_ALL_CLUSTERS_APP
	bool "Enable All Clusters App Example"
endchoice

endif
```

## apps/netutils/libwebsockets/Kconfig
```kconfig
#
# For a description of the syntax of this configuration file,
# see the file kconfig-language.txt in the NuttX tools repository.
#

config NETUTILS_LIBWEBSOCKETS
	bool "libwebsockets library (current version)"
	default n
	depends on NET_TCPPROTO_OPTIONS && OPENSSL_MBEDTLS_WRAPPER
	---help---
		Enables the libwebsockets library.

config NETUTILS_LIBWEBSOCKETS_TEST
	tristate "Enable libwebsockets test"
	default n

if NETUTILS_LIBWEBSOCKETS

config NETUTILS_LIBWEBSOCKETS_VERSION
	string "Version number"
	default "4.3.1"

config NETUTILS_LIBWEBSOCKETS_CERTS
	string "Libwebsocket Certificate Authorize Path"
	default "/etc/ssl/curl"
	depends on CRYPTO_MBEDTLS

endif

if NETUTILS_LIBWEBSOCKETS_TEST

config NETUTILS_LIBWEBSOCKETS_TEST_STACKSIZE
	int "Task's stack size"
	default 8192

endif
```

## apps/netutils/nng/Kconfig
```kconfig
#
# For a description of the syntax of this configuration file,
# see the file kconfig-language.txt in the NuttX tools repository.
#

config NETUTILS_NNG
	bool "Enable Nanomsg NG"
	default n
	---help---
		Enable Nanomsg-NG library. NNG is a lightweight, broker-less library,
		offering a simple API to solve common recurring messaging problems,
		such as publish/subscribe, RPC-style request/reply, or service discovery.

if NETUTILS_NNG

config NETUTILS_NNG_VERSION
	string "NNG Version"
	default "1.5.2"

config NETUTILS_NNG_HAVE_EPOLL
	bool "Build with epoll"
	default n
	---help---
		If this option is selected, an epoll based poll gueue
		is included in the build. Otherwise poll based queue
		is included in the build.

choice
	prompt "TLS engine"
	default NETUTILS_NNG_USE_NONE

config NETUTILS_NNG_USE_NONE
	bool "None"

config NETUTILS_NNG_USE_MBEDTLS
	bool "MbedTLS"
	select CRYPTO_MBEDTLS

endchoice # TLS engine

config NETUTILS_NNG_TEST
	tristate "Enable NNG test"
	default n
	help
		Enable the NNG test.

if NETUTILS_NNG_TEST

config NETUTILS_NNG_TEST_PRIORITY
	int "NNG test priority"
	default 100

config NETUTILS_NNG_TEST_STACKSIZE
	int "NNG test stack size"
	default DEFAULT_TASK_STACKSIZE

endif # NETUTILS_NNG_TEST

endif
```

## apps/netutils/rpmsg_tun/Kconfig
```kconfig
#
# For a description of the syntax of this configuration file,
# see the file kconfig-language.txt in the NuttX tools repository.
#

config NETUTILS_RPMSG_TUN
	bool
	depends on RPMSG && NET_TUN
	default n
	---help---
		If NETUTILS_RPMSG_TUN is enabled, it allows using
		a TUN device to send and receive data via RPMsg socket.

config NETUTILS_RPMSG_TUN_CLIENT
	tristate "Remote tun device with rpmsg socket client"
	select NETUTILS_RPMSG_TUN
	default n

config NETUTILS_RPMSG_TUN_SERVER
	tristate "Remote tun device with rpmsg socket server"
	depends on NET_NETLINK
	select NETUTILS_RPMSG_TUN
	default n

if NETUTILS_RPMSG_TUN

config NETUTILS_RPMSG_TUN_PRIORITY
	int "Remote tun device with rpmsg socket task priority"
	default 100

config NETUTILS_RPMSG_TUN_STACKSIZE
	int "Remote tun device with rpmsg socket task stack size"
	default 6144

config NETUTILS_RPMSG_TUN_BUFSIZE
	int "Remote tun buffer size"
	default 2048

endif
```

## apps/system/acpica/Kconfig
```kconfig
#
# For a description of the syntax of this configuration file,
# see the file kconfig-language.txt in the NuttX tools repository.
#

menuconfig SYSTEM_ACPICA
	tristate "ACPI tools support"
	default n
	---help---
		Enable support for ACPI parsing tools such as iASL.

if SYSTEM_ACPICA

config ACPICA_PROGNAME
	string "Program name"
	default "acpica"
	---help---
		This is the name of the program that will be used.

config ACPICA_STACKSIZE
	int "Stack size"
	default DEFAULT_TASK_STACKSIZE
	---help---
		The size of stack allocated for the acpica daemon task.

config ACPICA_PRIORITY
	int "Task priority"
	default 100
	---help---
		The priority of the acpica daemon task.

endif # SYSTEM_ACPICA
```

## apps/system/fbcapture/Kconfig
```kconfig
#
# For a description of the syntax of this configuration file,
# see the file kconfig-language.txt in the NuttX tools repository.
#

menuconfig FBCAPTURE
	tristate "Framebuffer Capture Tool"
	default n
	depends on VIDEO_FB
	---help---
		A tool to capture the framebuffer and save it as a BMP image.

if FBCAPTURE

config FBCAPTURE_STACKSIZE
	int "FBcapture stack size"
	default 4096
	---help---
		The stack size to use the FBcapture tool.

config FBCAPTURE_PRIORITY
	int "FBcapture priority"
	default 100
	---help---
		The priority to use the FBcapture tool.

endif
```

## apps/system/perf-tools/Kconfig
```kconfig
#
# For a description of the syntax of this configuration file,
# see the file kconfig-language.txt in the NuttX tools repository.
#

config PERF_TOOLS
	tristate "Performance analysis utility"
	default n
	---help---
		Performance analysis utility

if PERF_TOOLS

config PERF_TOOLS_PRIORITY
	int "Perf tools task priority"
	default 100

config PERF_TOOLS_STACKSIZE
	int "Perf tools stack size"
	default DEFAULT_TASK_STACKSIZE

endif
```

## apps/system/uorb/Kconfig
```kconfig
#
# For a description of the syntax of this configuration file,
# see the file kconfig-language.txt in the NuttX tools repository.
#

menuconfig UORB
	tristate "uorb(micro object request broker)"
	depends on SENSORS && USENSOR
	default n

if UORB

config UORB_PRIORITY
	int "task priority"
	default 220

config UORB_STACKSIZE
	int "stack size"
	default 8192

config UORB_LISTENER
	bool "uorb listener"
	default n

config UORB_GENERATOR
	bool "uorb generator"
	default n

config UORB_TESTS
	bool "uorb unit tests"
	default n

config UORB_ADVERTISE_DEMO
	bool "enable uorb advertise demo"
	default n

config UORB_RPMSG_TEST
	depends on RPMSG
	bool "enable uorb rpmsg test"
	default n

config UORB_DOWNSAMPLING_TEST
	bool "enable uorb downsampling test"
	default n

config UORB_LOOP_MAX_EVENTS
	int "uorb loop max events"
	depends on EVENT_FD
	default 0

if UORB_TESTS

config UORB_STORAGE_DIR
	string "uorb test result storage dir"
	default "/data/"

endif # UORB_TESTS

config DEBUG_UORB
	bool "uorb debug output"
	select LIBC_PRINT_EXTENSION
	default n

if DEBUG_UORB

config UORB_ALERT
	bool "uorb panic output"
	default n
	depends on DEBUG_ALERT

config UORB_ERROR
	bool "uorb error output"
	default n
	depends on DEBUG_ERROR

config UORB_WARN
	bool "uorb warn output"
	default n
	depends on DEBUG_WARN

config UORB_INFO
	bool "uorb info output"
	default n
	depends on DEBUG_INFO

endif # DEBUG_UORB

endif # UORB
```

## apps/testing/arch/irqnest/Kconfig
```kconfig
#
# For a description of the syntax of this configuration file,
# see the file kconfig-language.txt in the NuttX tools repository.
#

config TESTING_IRQNEST
	tristate "IRQ nesting test"
	default n
	depends on ARCH_HAVE_IRQTRIGGER && ARCH_IRQPRIO
	---help---
		Enable irqnest test app

if TESTING_IRQNEST

config TESTING_IRQNEST_PROGNAME
	string "Program name"
	default "irqnest"
	---help---
		This is name of the program when NSH is used.

config TESTING_IRQNEST_PRIORITY
	int "Task priority"
	default 100

config TESTING_IRQNEST_STACKSIZE
	int "stack size"
	default DEFAULT_TASK_STACKSIZE

config TESTING_IRQNEST_IRQ_LO
	int "Low prio test IRQ number"
	default 39

config TESTING_IRQNEST_PRI_LO
	int "Low prio IRQ priority"
	default 1

config TESTING_IRQNEST_IRQ_HI
	int "High prio test IRQ number"
	default 40

config TESTING_IRQNEST_PRI_HI
	int "High prio IRQ priority"
	default 2

endif
```

## apps/testing/crypto/psa-arch-tests/Kconfig
```kconfig
#
# For a description of the syntax of this configuration file,
# see the file kconfig-language.txt in the NuttX tools repository.
#

config PSA_ARCH_TESTS
	tristate "psa testing"
	default n
	---help---
		Enable the psa testing

if PSA_ARCH_TESTS

config PSA_ARCH_CRYPTO_TESTS
	bool "Enable the psa arch crypto tests"
	default n

config PSA_ARCH_ITS_TESTS
	bool "ENABLE the psa_arch its tests"
	default n

config PSA_ARCH_TESTS_PROGNAME
	string "Program name"
	default "psa_arch_test"

config PSA_ARCH_TESTS_PRIORITY
	int "psa arch test task priority"
	default 100

config PSA_ARCH_TESTS_STACKSIZE
	int "psa arch test stack size"
	default 8192

endif
```

## apps/testing/drivers/can_chrdev/Kconfig
```kconfig
#
# For a description of the syntax of this configuration file,
# see the file kconfig-language.txt in the NuttX tools repository.
#

config TESTING_CHARCAN
	tristate "vela auto tests for charcan"
	default n
	depends on TESTING_CMOCKA && CAN
	---help---
		Unit test for Can

if TESTING_CHARCAN
config TESTING_CHARCAN_PROGNAME
	string "Program name"
	default "cmocka_canecho"
	---help---
		This is the name of the cmocka program that will be used as Can test.

config TESTING_CHARCAN_PRIORITY
	int "Task priority"
	default 100

config TESTING_CHARCAN_STACKSIZE
	int "Task stack size"
	default 8192

config TESTING_CHARCAN_SENDER_DEVICE
	string "Sender Device Path"
	default "/dev/can0"
	---help---
		The device path for Can test.

config TESTING_CHARCAN_RECEIVER_DEVICE
	string "Receiver Device Path"
	default "/dev/can1"
	---help---
		The device path for Can test.

config TESTING_CHARCAN_CANMSG_ID
	int "Can Message ID"
	default 273
	---help---
		The Can message ID for chrdev Can test.

endif
```

## apps/testing/fs/fs_testsuites/Kconfig
```kconfig
#
# For a description of the syntax of this configuration file,
# see the file kconfig-language.txt in the NuttX tools repository.
#

config TESTING_FS_TESTSUITES
	tristate "FS Testsuites"
	default n
	depends on TESTING_CMOCKA
	---help---
		Enable FS Test for NuttX

config TESTING_FS_TESTSUITES_PRIORITY
	int "Task priority"
	default 100
	depends on TESTING_FS_TESTSUITES

config TESTING_FS_TESTSUITES_STACKSIZE
	int "Task stack size"
	default DEFAULT_TASK_STACKSIZE
	depends on TESTING_FS_TESTSUITES

if TESTING_FS_TESTSUITES

config TESTING_FS_TESTSUITES_MTD
	bool "MTD tests"
	default n
	depends on TESTING_FS_TESTSUITES
	depends on RAMMTD
	---help---
		Enable FTL tests

if TESTING_FS_TESTSUITES_MTD

config TESTING_FS_TESTSUITES_RAMMTD_BUFFERSIZE
	int "Rammtd tests buffer size"
	default 8192
	depends on TESTING_FS_TESTSUITES_MTD
	---help---
		Rammtd tests buffer size, it needs to be a multiple of
		CONFIG_RAMMTD_ERASESIZE

endif #TESTING_FS_TESTSUITES_MTD
endif #TESTING_FS_TESTSUITES
```
